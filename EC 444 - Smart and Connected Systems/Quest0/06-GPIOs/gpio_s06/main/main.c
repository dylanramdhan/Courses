// This code block was generated by {Alejandro Roberto} using {chat.openai.com
//GPT-3.5} on {9/8/2023} the entirety of the code was AI generate
#include <stdio.h>
#include <stdint.h>
#include "freertos/FreeRTOS.h"
#include "freertos/task.h"
#include "driver/gpio.h"

#define PIN_LED_0 13
#define PIN_LED_1 12
#define PIN_LED_2 27
#define PIN_LED_3 33

void displayBinary(uint8_t count) {
    gpio_set_level(PIN_LED_0, (count & 0x08) >> 3); // MSB
    gpio_set_level(PIN_LED_1, (count & 0x04) >> 2);
    gpio_set_level(PIN_LED_2, (count & 0x02) >> 1);
    gpio_set_level(PIN_LED_3, (count & 0x01));      // LSB
}

void binaryCounterTask(void *pvParameter) {
    while (1) {
        // Count from 0 to 15
        for (uint8_t count = 0; count <= 15; count++) {
            displayBinary(count);
            vTaskDelay(pdMS_TO_TICKS(1000)); // 1-second delay
        }

        // Count in reverse from 15 to 1
        for (uint8_t count = 15; count >= 1; count--) {
            displayBinary(count);
            vTaskDelay(pdMS_TO_TICKS(1000)); // 1-second delay
        }
    }
}

void app_main() {
    // Configure GPIO pins as OUTPUT
    gpio_config_t io_conf;
    io_conf.intr_type = GPIO_INTR_DISABLE;
    io_conf.mode = GPIO_MODE_OUTPUT;
    io_conf.pin_bit_mask = (1ULL << PIN_LED_0) | (1ULL << PIN_LED_1) | (1ULL << PIN_LED_2) | (1ULL << PIN_LED_3);
    io_conf.pull_down_en = 0;
    io_conf.pull_up_en = 0;
    gpio_config(&io_conf);

    // Create a binary counter task
    xTaskCreate(&binaryCounterTask, "binary_counter_task", 2048, NULL, 5, NULL);
}